## CMakeLists.txt
```
# Copyright (c) 2024 Google LLC
# SPDX-License-Identifier: Apache-2.0

cmake_minimum_required(VERSION 3.20)
find_package(Zephyr REQUIRED HINTS $ENV{ZEPHYR_BASE})

project(sensor-sandbox LANGUAGES C CXX)

target_sources(app PRIVATE src/main.cc)
```

## prj.conf
```kconfig
# Copyright (c) 2024 Google LLC
# SPDX-License-Identifier: Apache-2.0

# C++ configs
CONFIG_CPP=y
CONFIG_STD_CPP17=y
CONFIG_REQUIRES_FULL_LIBCPP=y

# Logging
CONFIG_LOG=y
```

## src/main.cc
```c
/* Copyright (c) 2024 Google LLC
 * SPDX-License-Identifier: Apache-2.0
 */

#include "pw_log/log.h"

int main() {
  PW_LOG_INFO("Hello World!");
  return 0;
}
```
