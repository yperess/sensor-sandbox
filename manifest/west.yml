## manifest/west.yml
```yaml
# Copyright (c) 2024 Google LLC
# SPDX-License-Identifier: Apache-2.0

manifest:
  projects:
    - import: false
      name: pigweed
      path: third_party/pigweed
      remote: yperess
      revision: pw_sensor
    - import: true
      name: zephyr
      path: third_party/zephyr
      remote: yperess
      revision: pw_sensor
  remotes:
    - name: yperess
      url-base: git@github.com:yperess
```
